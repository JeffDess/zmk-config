## config/west.yml
```yaml
manifest:
  remotes:
    - name: urob
      url-base: https://github.com/urob/
    - name: gpeye
      url-base: https://github.com/GPeye
  projects:
    - name: zmk
      remote: urob
      revision: main
      import: app/west.yml
    - name: zmk-helpers
      remote: urob
      revision: main
    - name: urchin-peripheral-animation
      remote: gpeye
      revision: main
  self:
    path: config
```
