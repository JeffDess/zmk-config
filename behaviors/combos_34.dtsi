#include <behaviors.dtsi>
#include <dt-bindings/zmk/keys.h>
#include "zmk-helpers/helper.h"
#include "zmk-helpers/key-labels/34.h"
#include "./combos.dtsi"
#include "../config/constants.h"

#pragma once

// NOTE: Only thumb keys are different between 34/36 layouts
//       All other combos should be in ./combos.dtsi

/***********************
  THUMBS
***********************/

// TAB - Right thumbs, active on all alpha layers
ZMK_COMBO(tab_34, &kp TAB, RH0 RH1, QWE COL ERG)

// Colemak/QWERTY - Inner thumbs, active on base and Colemak layers
ZMK_COMBO(qwerty_34, &tog QWE, LH0 RH0, COL QWE)

// Colemak/Ergo-L - Outer thumbs, active on base and Ergo-L layers
ZMK_COMBO(ergol_34, &tog ERG, LH1 RH1, COL ERG)

// Ergo-L -> QWERTY - Inner thumbs, active on Ergo-L
ZMK_COMBO(ergol_qwerty_34, &to QWE, LH0 RH0, ERG)

// QWERTY -> Ergo-L - Outer thumbs, active on QWERTY
ZMK_COMBO(qwerty_ergol_34, &to ERG, LH1 RH1, QWE)
