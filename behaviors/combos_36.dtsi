#include "./combos.dtsi"

// NOTE: Only thumb keys are different between 34/36 layouts
//       All other combos should be in ./combos.dtsi

/***********************
  THUMBS
***********************/

// TAB - Inner right thumbs, active on all alpha layers
ZMK_COMBO(tab, &kp TAB, RH0 RH1, QWE COL ERG)

// Colemak/QWERTY - Inner thumbs, active on base and QWERTY layers
ZMK_COMBO(qwerty, &tog QWE, LH0 RH0, QWE COL)

// Colemak/Ergo-L - Outer thumbs, active on base and Ergo-L layers
ZMK_COMBO(ergol, &tog ERG, LH1 RH1, COL ERG)

// Ergo-L -> QWERTY - Inner thumbs, active on Ergo-L
ZMK_COMBO(ergol_qwerty, &to QWE, LH0 RH0, ERG)

// QWERTY -> Ergo-L - Outer thumbs, active on QWERTY
ZMK_COMBO(qwerty_ergol, &to ERG, LH1 RH1, QWE)

// NAV Toggle - Left thumbs, active on all alpha layers & NAV
ZMK_COMBO(nav_toggle, &tog NAV, LH0 LH1, QWE COL ERG NAV)
