#include <behaviors.dtsi>
#include <dt-bindings/zmk/keys.h>
#include "../zmk-nodefree-config/helper.h"
#include "../zmk-nodefree-config/keypos_def/keypos_36keys.h"
#include "../config/constants.h"
#include "../behaviors/macros.dtsi"

#pragma once

// Combos
#undef COMBO_TERM
#define COMBO_TERM 40  // timeout of 40ms (default is 30ms if omitted)
#define HR_TIMEOUT 30  // timeout on homerow is better a bit shorter

/***********************
  ALL LAYERS
***********************/

// NOTE: Other thumb key combos are in ./combos_34.dsti and combos_36.dtsi

// NOTE: Other mouse keys related combos in ./mouse.dtsi

/***********************
  BASE LAYER
***********************/

// CUT - Ctrl + X, active on base layer
ZMK_COMBO(cut, &kp LC(X), LB3 LB4, DEF COL ERG)

// COPY - Ctrl + C, active on base layer
ZMK_COMBO(copy, &kp LC(C), LB2 LB3, DEF COL ERG)

// PASTE - Ctrl + V, active on all layers
ZMK_COMBO(paste, &kp LC(V), LB1 LB2, DEF COL ERG)

// PRINT SCREEN - PrintScreen, active on base layer
ZMK_COMBO(printscreen, &kp PRINTSCREEN, RT3 RT4, DEF COL ERG)

// CAPS WORD - Both HR Shifts, active on base & accent layers
ZMK_COMBO(capsword, &caps_word, LM1 RM1, DEF ACC COL ERG)

// CAPS LOCK - Both HR Controls, active on base & accent layers
ZMK_COMBO(capslock, &kp CAPSLOCK, LM2 RM2, DEF ACC COL ERG)

// TMUX Prefix - active on base layer
ZMK_COMBO(tmux, &kp TMUX, LM2 LM3, DEF COL ERG, HR_TIMEOUT)

// TMUX Command - active on base layer
ZMK_COMBO(tmux_cmd, &TMUX_CMD, LM2 LM3 RM4, DEF COL ERG, HR_TIMEOUT)

// TMUX New Session - active on base layer
ZMK_COMBO(tmux_session, &TMUX_SESSION, LM2 LM3 LM4, DEF COL ERG, HR_TIMEOUT)

// Toggle Mouse Layer - active on base and mouse layers
ZMK_COMBO(toggle_mouse, &tog MOU, LT1 LT4, DEF MOU COL ERG)

// Toggle Game Layer - active on base and game layer
ZMK_COMBO(toggle_game, &tog GAM, RT1 RT4, DEF GAM COL ERG)

/***********************
  SYMBOL LAYER
***********************/

// FAT ARROW - Left index & middle fingers on home row, active on symbol layer
ZMK_COMBO(fat_arrow, &FAT_ARROW, LM1 LM2, SYM)

// THIN ARROW - Left index & middle fingers on bottom row, active on symbol layer
ZMK_COMBO(arrow, &ARROW, LB1 LB2, SYM)

// Lesser than or Equal - active on symbol layer
ZMK_COMBO(lte, &LTE, RB1 RB2, SYM)

// Greater than or Equal - active on symbol layer
ZMK_COMBO(gte, &GTE, RB2 RB3, SYM)
