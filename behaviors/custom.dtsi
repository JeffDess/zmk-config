#include <behaviors.dtsi>
#include <dt-bindings/zmk/keys.h>
#include "../zmk-nodefree-config/helper.h"
#include "../zmk-nodefree-config/keypos_def/keypos_42keys.h"

/* Custom Behaviors */

// homerow mods
ZMK_BEHAVIOR(hrm, hold_tap,
    flavor = "balanced";
    tapping-term-ms = <280>;
    quick-tap-ms = <125>;
    global-quick-tap;
    bindings = <&kp>, <&kp>;
)

// tap: sticky shift | double tap: capsword
ZMK_BEHAVIOR(ss_cw, tap_dance,
    tapping-term-ms = <200>;
    bindings = <&sk LSHFT>, <&caps_word>;
)

// tap: backspace | shift + tap: delete
ZMK_BEHAVIOR(bspc_del, mod_morph,
    bindings = <&kp BSPC>, <&kp DEL>;
    mods = <(MOD_LSFT|MOD_RSFT)>;
)

// tap: backspace | shift + tap: delete | hold: nav layer
ZMK_BEHAVIOR(bs_del_nav, mod_morph,
    bindings = <&lt NAV BSPC>, <&kp DEL>;
    mods = <(MOD_LSFT|MOD_RSFT)>;
)

// tap: plus | shift + tap: minus
ZMK_BEHAVIOR(plus_minus, mod_morph,
    bindings = <&kp PLUS>, <&kp MINUS>;
    mods = <(MOD_LSFT|MOD_RSFT)>;
)

// tap: multiply | shift + tap: divide
ZMK_BEHAVIOR(multi_div, mod_morph,
    bindings = <&kp STAR>, <&kp FSLH>;
    mods = <(MOD_LSFT|MOD_RSFT)>;
)

// tap: dash | shift + tap: tilde
ZMK_BEHAVIOR(dash_tildle, mod_morph,
    bindings = <&kp MINUS>, <&TILDS>;
    mods = <(MOD_LSFT|MOD_RSFT)>;
)

// tap: comma | shift + tap: period
ZMK_BEHAVIOR(comma_dot, mod_morph,
    bindings = <&kp COMMA>, <&kp DOT>;
    mods = <(MOD_LSFT|MOD_RSFT)>;
)
